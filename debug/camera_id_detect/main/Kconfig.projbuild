## examples/es8311_spiffs/sdkconfig.defaults
```kconfig
CONFIG_IDF_TARGET="esp32p4"
CONFIG_IDF_TARGET_ESP32P4=y

CONFIG_PARTITION_TABLE_CUSTOM=y
CONFIG_PARTITION_TABLE_CUSTOM_FILENAME="partitions_16MB.csv"
CONFIG_PARTITION_TABLE_FILENAME="partitions_16MB.csv"
CONFIG_PARTITION_TABLE_OFFSET=0x8000
CONFIG_PARTITION_TABLE_MD5=y

CONFIG_ESPTOOLPY_FLASHSIZE_16MB=y
CONFIG_BOOTLOADER_LOG_COLORS=y
CONFIG_BOOTLOADER_LOG_TIMESTAMP_SOURCE_CPU_TICKS=y
CONFIG_FREERTOS_HZ=1000
CONFIG_AUDIO_PLAYER_LOG_LEVEL=0
```

## examples/factory/main/Kconfig.projbuild
```kconfig
menu "Factory Example"


config FACTORY_BOOT_BUTTON_GPIO
    int "BOOT button GPIO for full refresh (-1 disables)"
    default 35
    range -1 54
    help
        Pressing the BOOT button requests one e-paper full refresh. Keep the
        default GPIO35 for the ESP32-P4 BOOT key. The button is pulled up and
        active low.

menu "Display"

config FACTORY_DISPLAY_TEST_LOCAL_REFRESH_MS
    int "Display test local refresh period (ms)"
    default 1200
    range 100 60000

config FACTORY_DISPLAY_TEST_FULL_REFRESH_MS
    int "Display test automatic full refresh period (ms)"
    default 30000
    range 1000 600000
    
endmenu

menu "Touch"

config FACTORY_TOUCH_I2C_ADDR
    hex "GT911 7-bit I2C address"
    default 0x5D
    range 0x00 0x7F

config FACTORY_TOUCH_I2C_SDA
    int "Shared I2C SDA GPIO"
    default 7
    range 0 54

config FACTORY_TOUCH_I2C_SCL
    int "Shared I2C SCL GPIO"
    default 8
    range 0 54

config FACTORY_TOUCH_INT_GPIO
    int "Touch interrupt GPIO"
    default 3
    range 0 54

endmenu

menu "Battery"

config FACTORY_BATTERY_BQ25896_ADDR
    hex "BQ25896 7-bit I2C address"
    default 0x6B
    range 0x00 0x7F

config FACTORY_BATTERY_BQ27220_ADDR
    hex "BQ27220 7-bit I2C address"
    default 0x55
    range 0x00 0x7F

config FACTORY_BATTERY_REFRESH_MS
    int "Battery page refresh period (ms)"
    default 2000
    range 500 60000

config FACTORY_BATTERY_CAPACITY_MAH
    int "Battery design capacity (mAh)"
    default 1100
    range 100 5000

config FACTORY_BATTERY_CHARGE_CURRENT_MA
    int "Battery fast charge current (mA)"
    default 512
    range 0 1000

config FACTORY_BATTERY_PRECHARGE_CURRENT_MA
    int "Battery precharge current (mA)"
    default 64
    range 0 1000

config FACTORY_BATTERY_TERM_CURRENT_MA
    int "Battery termination current (mA)"
    default 64
    range 0 1000

config FACTORY_BATTERY_CHARGE_VOLTAGE_MV
    int "Battery charge voltage (mV)"
    default 4208
    range 3000 4600

config FACTORY_BATTERY_TERM_VOLTAGE_DELTA_MV
    int "Battery charge termination voltage delta (mV)"
    default 100
    range 0 1000

config FACTORY_BATTERY_SYSTEM_MIN_MV
    int "Battery minimum system voltage (mV)"
    default 3300
    range 2500 3700

config FACTORY_BATTERY_CURRENT_THRESHOLD_MA
    int "Battery state threshold current (mA)"
    default 20
    range 0 500

config FACTORY_BATTERY_LOW_VOLTAGE_MV
    int "Battery low-voltage protection threshold (mV)"
    default 3300
    range 2500 4000

config FACTORY_BATTERY_LOW_POWER_COUNTDOWN_SEC
    int "Battery low-voltage shutdown countdown (s)"
    default 20
    range 1 120

config FACTORY_BATTERY_LOW_POWER_POLL_MS
    int "Battery low-voltage monitor polling period (ms)"
    default 250
    range 100 5000

endmenu

menu "Camera"

config FACTORY_CAMERA_ENABLE
    bool "Enable instant camera page"
    default y
    select ESP_VIDEO_ENABLE_MIPI_CSI_VIDEO_DEVICE
    select ESP_VIDEO_ENABLE_ISP_VIDEO_DEVICE
    select ESP_VIDEO_ENABLE_ISP_PIPELINE_CONTROLLER
    select CAMERA_XCLK_USE_ESP_CLOCK_ROUTER

choice FACTORY_CAMERA_SENSOR
    prompt "Camera sensor"
    depends on FACTORY_CAMERA_ENABLE
    default FACTORY_CAMERA_SENSOR_OV2710

    config FACTORY_CAMERA_SENSOR_OV2710
        bool "OV2710"
        select CAMERA_OV2710
        select CAMERA_OV2710_MIPI_RAW10_1280X720_25FPS

    config FACTORY_CAMERA_SENSOR_SC2336
        bool "SC2336"
        select CAMERA_SC2336
        select CAMERA_SC2336_MIPI_RAW8_1280X720_30FPS

    config FACTORY_CAMERA_SENSOR_OV5645
        bool "OV5645"
        select CAMERA_OV5645
        select CAMERA_OV5645_MIPI_YUV422_1280X960_30FPS
endchoice

config FACTORY_CAMERA_I2C_FREQ_HZ
    int "Camera SCCB/I2C frequency (Hz)"
    depends on FACTORY_CAMERA_ENABLE
    default 100000
    range 10000 400000

config FACTORY_CAMERA_ENABLE_POWER
    bool "Enable camera rails through SGM38121"
    depends on FACTORY_CAMERA_ENABLE
    default y

config FACTORY_CAMERA_DVDD1_MV
    int "SGM38121 DVDD1 target voltage (mV, 0 disables)"
    depends on FACTORY_CAMERA_ENABLE_POWER
    default 0
    range 0 1504

config FACTORY_CAMERA_DVDD2_MV
    int "SGM38121 DVDD2 target voltage (mV, 0 disables)"
    depends on FACTORY_CAMERA_ENABLE_POWER
    default 0
    range 0 1504

config FACTORY_CAMERA_AVDD1_MV
    int "SGM38121 AVDD1 target voltage (mV)"
    depends on FACTORY_CAMERA_ENABLE_POWER
    default 1800
    range 1504 3424

config FACTORY_CAMERA_AVDD2_MV
    int "SGM38121 AVDD2 target voltage (mV)"
    depends on FACTORY_CAMERA_ENABLE_POWER
    default 2800
    range 1504 3424

config FACTORY_CAMERA_RESET_GPIO
    int "Camera RESET GPIO (-1 disables)"
    depends on FACTORY_CAMERA_ENABLE
    default -1
    range -1 54

config FACTORY_CAMERA_PWDN_GPIO
    int "Camera PWDN GPIO (-1 disables)"
    depends on FACTORY_CAMERA_ENABLE
    default -1
    range -1 54

config FACTORY_CAMERA_XCLK_GPIO
    int "Camera XCLK GPIO (-1 disables)"
    depends on FACTORY_CAMERA_ENABLE
    default -1
    range -1 54

config FACTORY_CAMERA_XCLK_FREQ_HZ
    int "Camera XCLK frequency (Hz)"
    depends on FACTORY_CAMERA_ENABLE
    default 24000000
    range 1000000 40000000

config FACTORY_CAMERA_CAPTURE_WIDTH
    int "Requested capture width"
    depends on FACTORY_CAMERA_ENABLE
    default 1280
    range 160 2592

config FACTORY_CAMERA_CAPTURE_HEIGHT
    int "Requested capture height"
    depends on FACTORY_CAMERA_ENABLE
    default 720
    range 120 1944

config FACTORY_CAMERA_OUTPUT_WIDTH
    int "Preview output width"
    depends on FACTORY_CAMERA_ENABLE
    default 640
    range 160 1440

config FACTORY_CAMERA_OUTPUT_HEIGHT
    int "Preview output height"
    depends on FACTORY_CAMERA_ENABLE
    default 360
    range 120 720

config FACTORY_CAMERA_VIDEO_BUFFER_COUNT
    int "V4L2 video buffer count"
    depends on FACTORY_CAMERA_ENABLE
    default 3
    range 2 4

config FACTORY_CAMERA_TASK_STACK_SIZE
    int "Camera capture task stack size"
    depends on FACTORY_CAMERA_ENABLE
    default 8192
    range 6144 16384

endmenu

menu "Audio"

config FACTORY_AUDIO_SAMPLE_RATE
    int "Audio showcase sample rate (Hz)"
    default 16000
    range 8000 48000
    help
        The ES8311 showcase uses a 256x MCLK coefficient table for common rates.
        Keep the default 16000 Hz for factory microphone and loopback tests.

config FACTORY_AUDIO_RECORD_SECONDS
    int "Audio showcase recording length (s)"
    default 3
    range 1 10

config FACTORY_AUDIO_VOLUME_PERCENT
    int "Audio showcase speaker volume (%)"
    default 70
    range 0 100

config FACTORY_AUDIO_LOOPBACK_VOLUME_PERCENT
    int "Audio showcase safe loopback speaker volume (%)"
    default 65
    range 0 100
    help
        Live mic-to-speaker loopback can create acoustic feedback when the
        microphone is close to the speaker. Keep this low for factory safety.

config FACTORY_AUDIO_LOOPBACK_GAIN_PERCENT
    int "Audio showcase safe loopback digital gain (%)"
    default 18
    range 0 100
    help
        Digital attenuation applied before writing microphone samples back to
        the speaker during loopback.

config FACTORY_AUDIO_LOOPBACK_LIMIT_PERCENT
    int "Audio showcase safe loopback output limiter (%)"
    default 18
    range 1 50
    help
        Maximum absolute PCM output level during loopback, as a percentage of
        full scale.

config FACTORY_AUDIO_MIC_GAIN_DB
    int "Audio showcase microphone gain (dB)"
    default 30
    range 0 42
    help
        Rounded to the nearest ES8311 6 dB gain step.

config FACTORY_AUDIO_MIC_PASS_PEAK_PERCENT
    int "Audio showcase microphone PASS peak threshold (%)"
    default 4
    range 1 100

config FACTORY_AUDIO_MONITOR_PERIOD_MS
    int "Audio showcase monitor polling period (ms)"
    default 120
    range 20 1000

config FACTORY_AUDIO_TASK_STACK_SIZE
    int "Audio showcase task stack size"
    default 6144
    range 4096 16384

endmenu

endmenu
```

## examples/factory/sdkconfig.defaults
```kconfig
CONFIG_IDF_TARGET="esp32p4"
CONFIG_IDF_TARGET_ESP32P4=y

CONFIG_PARTITION_TABLE_CUSTOM=y
CONFIG_PARTITION_TABLE_CUSTOM_FILENAME="partitions.csv"
CONFIG_PARTITION_TABLE_FILENAME="partitions.csv"
CONFIG_PARTITION_TABLE_OFFSET=0x8000
CONFIG_PARTITION_TABLE_MD5=y

CONFIG_ESPTOOLPY_FLASHSIZE_16MB=y
CONFIG_BOOTLOADER_LOG_COLORS=y
CONFIG_BOOTLOADER_LOG_TIMESTAMP_SOURCE_CPU_TICKS=y
CONFIG_COMPILER_OPTIMIZATION_PERF=y
CONFIG_FREERTOS_HZ=1000

CONFIG_SPIRAM=y
CONFIG_SPIRAM_SPEED_200M=y
CONFIG_SPIRAM_USE_MALLOC=y
CONFIG_SPIRAM_MEMTEST=n
CONFIG_CACHE_L2_CACHE_256KB=y
CONFIG_CACHE_L2_CACHE_LINE_128B=y

CONFIG_IDF_EXPERIMENTAL_FEATURES=y
CONFIG_LV_CONF_SKIP=n
CONFIG_LV_BUILD_EXAMPLES=n
CONFIG_LV_USE_THEME_MONO=y

CONFIG_FACTORY_HDMI_ENABLE=y
CONFIG_FACTORY_HDMI_TARGET_FPS=30

CONFIG_ESP_VIDEO_ENABLE_ISP_PIPELINE_CONTROLLER=y
CONFIG_FACTORY_CAMERA_SENSOR_OV2710=y
CONFIG_CAMERA_OV2710_MIPI_DEFAULT_FMT_RAW10_1280X720_25FPS=y

# Hosted WiFi baseline aligned with examples/c6_wifi_scan.
CONFIG_SLAVE_IDF_TARGET_ESP32C6=y
CONFIG_ESP_HOSTED_P4_DEV_BOARD_FUNC_BOARD=y
CONFIG_ESP_HOSTED_CP_TARGET_ESP32C6=y
CONFIG_ESP_WIFI_REMOTE_LIBRARY_HOSTED=y
CONFIG_WIFI_RMT_STATIC_RX_BUFFER_NUM=16
CONFIG_WIFI_RMT_DYNAMIC_RX_BUFFER_NUM=64
CONFIG_WIFI_RMT_DYNAMIC_TX_BUFFER_NUM=64
CONFIG_WIFI_RMT_AMPDU_TX_ENABLED=y
CONFIG_WIFI_RMT_TX_BA_WIN=32
CONFIG_WIFI_RMT_AMPDU_RX_ENABLED=y
CONFIG_WIFI_RMT_RX_BA_WIN=32
CONFIG_LWIP_TCP_SND_BUF_DEFAULT=65534
CONFIG_LWIP_TCP_WND_DEFAULT=65534
CONFIG_LWIP_TCP_RECVMBOX_SIZE=64
CONFIG_LWIP_UDP_RECVMBOX_SIZE=64
CONFIG_LWIP_TCPIP_RECVMBOX_SIZE=64
CONFIG_LWIP_TCP_SACK_OUT=y
```

## examples/hdmi_video_renderer_lvgl/main/Kconfig.projbuild
```kconfig
menu "HDMI LVGL Demo Configuration"

    config HDMI_LVGL_DRAW_BUF_LINES
        int "LVGL partial draw buffer height"
        default 128
        range 16 256
        help
            Number of display lines in each of the two LVGL draw buffers.
            Larger values reduce PPA transaction overhead but consume more
            PSRAM. 128 lines is a balanced default for 1920x1080 output.

    choice HDMI_LVGL_DEMO
        prompt "Select LVGL demo"
        default HDMI_LVGL_DEMO_BENCHMARK
        help
            Select the LVGL demo that starts automatically after HDMI display
            initialization.

        config HDMI_LVGL_DEMO_BENCHMARK
            bool "Benchmark"
            select LV_USE_DEMO_BENCHMARK
            help
                Run LVGL's benchmark demo to measure rendering performance.

        config HDMI_LVGL_DEMO_STRESS
            bool "Stress"
            select LV_USE_DEMO_STRESS
            help
                Run LVGL's stress demo to exercise object creation and drawing.

        config HDMI_LVGL_DEMO_WIDGETS
            bool "Widgets"
            select LV_USE_DEMO_WIDGETS
            select LV_DEMO_WIDGETS_SLIDESHOW
            help
                Run LVGL's widgets demo. Slideshow mode is enabled so the demo
                remains useful without touch, keyboard, or encoder input.
    endchoice

endmenu
```

## examples/icm20948/main/Kconfig.projbuild
```kconfig
menu "ICM20948 Example Configuration"

config ICM20948_I2C_FREQ_HZ
    int "I2C clock frequency (Hz)"
    range 10000 400000
    default 400000

config ICM20948_SAMPLE_PERIOD_MS
    int "Serial output period (ms)"
    range 20 60000
    default 200

endmenu
```

## examples/pca9535/sdkconfig.defaults.esp32p4
```kconfig
CONFIG_IDF_TARGET="esp32p4"
CONFIG_IDF_TARGET_ESP32P4=y

#
# Partition Table
#
CONFIG_PARTITION_TABLE_CUSTOM=y
CONFIG_PARTITION_TABLE_CUSTOM_FILENAME="partitions.csv"
CONFIG_PARTITION_TABLE_FILENAME="partitions.csv"
CONFIG_PARTITION_TABLE_OFFSET=0x8000
CONFIG_PARTITION_TABLE_MD5=y

#
# Serial flasher config
#
CONFIG_ESPTOOLPY_FLASHSIZE_16MB=y

#
# Format
#
CONFIG_BOOTLOADER_LOG_COLORS=y
CONFIG_BOOTLOADER_LOG_TIMESTAMP_SOURCE_CPU_TICKS=y

#
# FREERTOS
#
CONFIG_FREERTOS_HZ=1000
```

## examples/sd_card_test/main/Kconfig.projbuild
```kconfig
menu "SD card test"

    config SD_CARD_TEST_MOUNT_POINT
        string "SD card mount point"
        default "/sdcard"

    config SD_CARD_TEST_FILE_NAME
        string "Test file name"
        default "sdtest.txt"
        help
            Keep the default 8.3-style name unless FATFS long filename support
            is enabled. Long names may fail with EINVAL when CONFIG_FATFS_LFN_NONE
            is selected.

    config SD_CARD_TEST_FORMAT_ON_MOUNT_FAIL
        bool "Format SD card if mounting fails"
        default n
        help
            Enable only when you are comfortable erasing the card contents.

    config SD_CARD_TEST_MAX_FREQ_KHZ
        int "SDSPI max frequency in kHz"
        default 20000
        range 400 20000

    config SD_CARD_TEST_PIN_MISO
        int "SDSPI MISO GPIO"
        default 44
        range 0 54

    config SD_CARD_TEST_PIN_MOSI
        int "SDSPI MOSI GPIO"
        default 46
        range 0 54

    config SD_CARD_TEST_PIN_CLK
        int "SDSPI CLK GPIO"
        default 45
        range 0 54

    config SD_CARD_TEST_PIN_CS
        int "SDSPI CS GPIO"
        default 47
        range 0 54

    config SD_CARD_TEST_SPEED_TEST
        bool "Run read/write speed test"
        default y

    config SD_CARD_TEST_SPEED_FILE_NAME
        string "Speed test file name"
        default "sdbench.bin"
        depends on SD_CARD_TEST_SPEED_TEST
        help
            Keep the default 8.3-style name unless FATFS long filename support
            is enabled.

    config SD_CARD_TEST_SPEED_SIZE_KB
        int "Speed test size in KiB"
        default 1024
        range 4 32768
        depends on SD_CARD_TEST_SPEED_TEST

    config SD_CARD_TEST_SPEED_BLOCK_SIZE
        int "Speed test block size in bytes"
        default 16384
        range 512 65536
        depends on SD_CARD_TEST_SPEED_TEST

endmenu
```
