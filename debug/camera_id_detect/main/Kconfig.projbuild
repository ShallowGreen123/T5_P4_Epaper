## debug/camera_id_detect/main/Kconfig.projbuild
```kconfig
menu "Camera ID Detect Configuration"

config CAMERA_ID_DETECT_I2C_SDA
    int "I2C SDA GPIO"
    range 0 54
    default 7

config CAMERA_ID_DETECT_I2C_SCL
    int "I2C SCL GPIO"
    range 0 54
    default 8

config CAMERA_ID_DETECT_I2C_FREQ_HZ
    int "I2C/SCCB clock frequency (Hz)"
    range 10000 400000
    default 400000

config CAMERA_ID_DETECT_ENABLE_CAMERA_POWER
    bool "Enable camera power through SGM38121 on boot"
    default y

config CAMERA_ID_DETECT_AVDD1_MV
    int "AVDD1 target voltage (mV)"
    depends on CAMERA_ID_DETECT_ENABLE_CAMERA_POWER
    range 1504 3424
    default 1800

config CAMERA_ID_DETECT_AVDD2_MV
    int "AVDD2 target voltage (mV)"
    depends on CAMERA_ID_DETECT_ENABLE_CAMERA_POWER
    range 1504 3424
    default 2800

config CAMERA_ID_DETECT_RESET_GPIO
    int "Camera RESET GPIO (-1 to disable)"
    range -1 54
    default -1

config CAMERA_ID_DETECT_PWDN_GPIO
    int "Camera PWDN GPIO (-1 to disable)"
    range -1 54
    default -1

config CAMERA_ID_DETECT_XCLK_GPIO
    int "Camera XCLK GPIO (-1 to disable)"
    range -1 54
    default -1

config CAMERA_ID_DETECT_XCLK_FREQ_HZ
    int "Camera XCLK frequency (Hz)"
    range 1000000 40000000
    default 24000000
    help
        Ignored when XCLK GPIO is set to -1.

endmenu
```

## debug/camera_id_detect/sdkconfig.defaults
```kconfig
CONFIG_IDF_TARGET="esp32p4"
CONFIG_IDF_TARGET_ESP32P4=y

CONFIG_CAMERA_SC2336=y
CONFIG_CAMERA_OV2710=y
CONFIG_CAMERA_OV5645=y
```

## debug/icm20948/sdkconfig.defaults
```kconfig
CONFIG_IDF_TARGET="esp32p4"
CONFIG_IDF_TARGET_ESP32P4=y

#
# Serial flasher config
#
CONFIG_ESPTOOLPY_FLASHSIZE_16MB=y

#
# Format
#
CONFIG_BOOTLOADER_LOG_COLORS=y
CONFIG_BOOTLOADER_LOG_TIMESTAMP_SOURCE_CPU_TICKS=y

#
# FREERTOS
#
CONFIG_FREERTOS_HZ=1000
```

## debug/sgm38121/main/Kconfig.projbuild
```kconfig
menu "SGM38121 Test Configuration"

config SGM38121_I2C_SDA
    int "I2C SDA GPIO"
    range 0 54
    default 7

config SGM38121_I2C_SCL
    int "I2C SCL GPIO"
    range 0 54
    default 8

config SGM38121_I2C_FREQ_HZ
    int "I2C clock frequency (Hz)"
    range 10000 400000
    default 400000

config SGM38121_APPLY_CONFIG_ON_BOOT
    bool "Apply AVDD configuration on boot"
    default y

config SGM38121_ENABLE_AVDD1
    bool "Enable AVDD1 / CAM_1V8"
    default y

config SGM38121_AVDD1_MV
    int "AVDD1 target voltage (mV)"
    depends on SGM38121_ENABLE_AVDD1
    range 1504 3424
    default 1800

config SGM38121_ENABLE_AVDD2
    bool "Enable AVDD2 / CAM_2V8"
    default y

config SGM38121_AVDD2_MV
    int "AVDD2 target voltage (mV)"
    depends on SGM38121_ENABLE_AVDD2
    range 1504 3424
    default 2800

config SGM38121_DUMP_ALL_REGS_AT_BOOT
    bool "Dump registers 0x00-0x0F at boot"
    default y

config SGM38121_DUMP_ALL_REGS_PERIODICALLY
    bool "Dump registers 0x00-0x0F periodically"
    default n

config SGM38121_MONITOR_PERIOD_MS
    int "Status monitor period (ms)"
    range 250 60000
    default 2000

config SGM38121_TOGGLE_TEST
    bool "Toggle enabled outputs on/off periodically"
    default n

config SGM38121_TOGGLE_PERIOD_MS
    int "Toggle test period (ms)"
    depends on SGM38121_TOGGLE_TEST
    range 500 60000
    default 3000

endmenu
```

## examples/bq_power_dashboard/main/Kconfig.projbuild
```kconfig
menu "BQ Power Dashboard"

config BQ_POWER_DASHBOARD_I2C_SDA
    int "I2C SDA GPIO"
    default 7
    range 0 48

config BQ_POWER_DASHBOARD_I2C_SCL
    int "I2C SCL GPIO"
    default 8
    range 0 48

config BQ_POWER_DASHBOARD_I2C_FREQ_HZ
    int "I2C clock frequency (Hz)"
    default 400000
    range 10000 1000000

config BQ_POWER_DASHBOARD_BQ25896_ADDR
    hex "BQ25896 7-bit I2C address"
    default 0x6B
    range 0x00 0x7F

config BQ_POWER_DASHBOARD_BQ27220_ADDR
    hex "BQ27220 7-bit I2C address"
    default 0x55
    range 0x00 0x7F

config BQ_POWER_DASHBOARD_LOCAL_REFRESH_MS
    int "Local refresh period (ms)"
    default 5000
    range 1000 60000

config BQ_POWER_DASHBOARD_FULL_REFRESH_MS
    int "Full refresh period (ms)"
    default 120000
    range 10000 600000

endmenu
```

## examples/c6_wifi_scan/sdkconfig.defaults
```kconfig
CONFIG_IDF_TARGET="esp32p4"
CONFIG_IDF_TARGET_ESP32P4=y
CONFIG_ESP32P4_REV_MIN_301=y

#
# Partition Table
#
CONFIG_PARTITION_TABLE_CUSTOM=y
CONFIG_PARTITION_TABLE_CUSTOM_FILENAME="partitions.csv"
CONFIG_PARTITION_TABLE_FILENAME="partitions.csv"
CONFIG_PARTITION_TABLE_OFFSET=0x8000
CONFIG_PARTITION_TABLE_MD5=y

#
# Serial flasher config
#
CONFIG_ESPTOOLPY_FLASHSIZE_16MB=y

#
# Format
#
# Keep the IDF 6.1 bootloader within the space before the 0x8000 partition table.
CONFIG_BOOTLOADER_LOG_LEVEL_WARN=y
CONFIG_BOOTLOADER_LOG_COLORS=y
CONFIG_BOOTLOADER_LOG_TIMESTAMP_SOURCE_CPU_TICKS=y
CONFIG_ESPTOOLPY_NO_STUB=y
#
# FREERTOS
#
CONFIG_FREERTOS_HZ=1000
```

## examples/camera_wifi_stream/main/Kconfig.projbuild
```kconfig
menu "Camera WiFi Stream Configuration"

config CAMERA_WIFI_STREAM_WIFI_SSID
    string "WiFi SSID"
    default ""

config CAMERA_WIFI_STREAM_WIFI_PASSWORD
    string "WiFi password"
    default ""

config CAMERA_WIFI_STREAM_MAXIMUM_RETRY
    int "Maximum WiFi retry count"
    range 0 20
    default 5

config CAMERA_WIFI_STREAM_ENABLE_WIFI_PS
    bool "Enable WiFi power save while streaming"
    default n
    help
        Keep station power save enabled. The stream example disables it by default
        to reduce latency jitter on the ESP32-C6 hosted WiFi link.

config CAMERA_WIFI_STREAM_JPEG_QUALITY
    int "JPEG quality"
    range 1 100
    default 88

config CAMERA_WIFI_STREAM_MAX_STREAM_FPS
    int "Maximum MJPEG stream FPS (0 disables limit)"
    range 0 30
    default 12
    help
        Limit frames sent to the browser while still draining the camera driver.
        This lowers hosted WiFi bandwidth pressure and reduces visible stutter.

config CAMERA_WIFI_STREAM_VIDEO_BUFFER_COUNT
    int "Video capture buffer count"
    range 2 6
    default 4
    help
        More buffers absorb short JPEG encode or TCP send stalls. Higher values use
        more PSRAM.

choice CAMERA_WIFI_STREAM_SENSOR
    prompt "Camera sensor"
    default CAMERA_WIFI_STREAM_SENSOR_OV2710

    config CAMERA_WIFI_STREAM_SENSOR_OV2710
        bool "OV2710"
        select CAMERA_OV2710
        select CAMERA_OV2710_MIPI_RAW10_1280X720_25FPS

    config CAMERA_WIFI_STREAM_SENSOR_SC2336
        bool "SC2336"
        select CAMERA_SC2336
        select CAMERA_SC2336_MIPI_RAW8_1280X720_30FPS

    config CAMERA_WIFI_STREAM_SENSOR_OV5645
        bool "OV5645"
        select CAMERA_OV5645
        select CAMERA_OV5645_MIPI_YUV422_1280X960_30FPS
endchoice

config CAMERA_WIFI_STREAM_I2C_PORT
    int "I2C/SCCB port"
    range 0 2
    default 0

config CAMERA_WIFI_STREAM_I2C_SDA
    int "I2C/SCCB SDA GPIO"
    range 0 54
    default 7

config CAMERA_WIFI_STREAM_I2C_SCL
    int "I2C/SCCB SCL GPIO"
    range 0 54
    default 8

config CAMERA_WIFI_STREAM_I2C_FREQ_HZ
    int "I2C/SCCB clock frequency (Hz)"
    range 10000 400000
    default 100000

config CAMERA_WIFI_STREAM_ENABLE_CAMERA_POWER
    bool "Enable camera power through SGM38121 on boot"
    default y

config CAMERA_WIFI_STREAM_DVDD1_MV
    int "SGM38121 DVDD1 target voltage (mV, 0 disables)"
    depends on CAMERA_WIFI_STREAM_ENABLE_CAMERA_POWER
    range 0 1504
    default 0
    help
        Set to 0 to keep DVDD1 disabled. Non-zero values are rounded to the
        SGM38121 DVDD range of 528-1504 mV in 8 mV steps.

config CAMERA_WIFI_STREAM_DVDD2_MV
    int "SGM38121 DVDD2 target voltage (mV, 0 disables)"
    depends on CAMERA_WIFI_STREAM_ENABLE_CAMERA_POWER
    range 0 1504
    default 0
    help
        Set to 0 to keep DVDD2 disabled. Non-zero values are rounded to the
        SGM38121 DVDD range of 528-1504 mV in 8 mV steps.

config CAMERA_WIFI_STREAM_AVDD1_MV
    int "SGM38121 AVDD1 target voltage (mV)"
    depends on CAMERA_WIFI_STREAM_ENABLE_CAMERA_POWER
    range 1504 3424
    default 1800

config CAMERA_WIFI_STREAM_AVDD2_MV
    int "SGM38121 AVDD2 target voltage (mV)"
    depends on CAMERA_WIFI_STREAM_ENABLE_CAMERA_POWER
    range 1504 3424
    default 2800

config CAMERA_WIFI_STREAM_RESET_GPIO
    int "Camera RESET GPIO (-1 to disable)"
    range -1 54
    default -1

config CAMERA_WIFI_STREAM_PWDN_GPIO
    int "Camera PWDN GPIO (-1 to disable)"
    range -1 54
    default -1

config CAMERA_WIFI_STREAM_XCLK_GPIO
    int "Camera XCLK GPIO (-1 to disable)"
    range -1 54
    default -1

config CAMERA_WIFI_STREAM_XCLK_FREQ_HZ
    int "Camera XCLK frequency (Hz)"
    range 1000000 40000000
    default 24000000
    help
        Ignored when XCLK GPIO is set to -1.

endmenu
```

## examples/camera_wifi_stream/sdkconfig.defaults
```kconfig
CONFIG_IDF_TARGET="esp32p4"
CONFIG_IDF_TARGET_ESP32P4=y
CONFIG_ESP32P4_REV_MIN_301=y

CONFIG_PARTITION_TABLE_CUSTOM=y
CONFIG_PARTITION_TABLE_CUSTOM_FILENAME="partitions.csv"
CONFIG_PARTITION_TABLE_FILENAME="partitions.csv"
CONFIG_PARTITION_TABLE_OFFSET=0x8000
CONFIG_PARTITION_TABLE_MD5=y

CONFIG_ESPTOOLPY_FLASHSIZE_16MB=y
CONFIG_BOOTLOADER_LOG_LEVEL_WARN=y
CONFIG_BOOTLOADER_LOG_COLORS=y
CONFIG_BOOTLOADER_LOG_TIMESTAMP_SOURCE_CPU_TICKS=y
CONFIG_FREERTOS_HZ=1000
CONFIG_ESPTOOLPY_NO_STUB=y
```

## examples/camera_wifi_stream/sdkconfig.defaults.esp32p4
```kconfig
CONFIG_SLAVE_IDF_TARGET_ESP32C6=y
CONFIG_ESP_HOSTED_P4_DEV_BOARD_FUNC_BOARD=y
CONFIG_ESP_WIFI_REMOTE_LIBRARY_HOSTED=y
CONFIG_WIFI_RMT_STATIC_RX_BUFFER_NUM=16
CONFIG_WIFI_RMT_DYNAMIC_RX_BUFFER_NUM=64
CONFIG_WIFI_RMT_DYNAMIC_TX_BUFFER_NUM=64
CONFIG_WIFI_RMT_AMPDU_TX_ENABLED=y
CONFIG_WIFI_RMT_TX_BA_WIN=32
CONFIG_WIFI_RMT_AMPDU_RX_ENABLED=y
CONFIG_WIFI_RMT_RX_BA_WIN=32
CONFIG_LWIP_TCP_SND_BUF_DEFAULT=65534
CONFIG_LWIP_TCP_WND_DEFAULT=65534
CONFIG_LWIP_TCP_RECVMBOX_SIZE=64
CONFIG_LWIP_UDP_RECVMBOX_SIZE=64
CONFIG_LWIP_TCPIP_RECVMBOX_SIZE=64
CONFIG_LWIP_TCP_SACK_OUT=y

CONFIG_IDF_EXPERIMENTAL_FEATURES=y
CONFIG_SPIRAM=y
CONFIG_SPIRAM_SPEED_200M=y
CONFIG_ESP_VIDEO_ENABLE_ISP_PIPELINE_CONTROLLER=y

CONFIG_CAMERA_WIFI_STREAM_SENSOR_OV2710=y
CONFIG_CAMERA_OV2710_MIPI_DEFAULT_FMT_RAW10_1280X720_25FPS=y
```

## examples/crosspoint_reader_t5_p4/main/Kconfig.projbuild
```kconfig
menu "CrossPoint Reader"

config EPUB_READER_BOOK_DIR
    string "Primary book directory"
    default "/sdcard/books"

config EPUB_READER_FALLBACK_DIR
    string "Fallback book directory"
    default "/sdcard"

config EPUB_READER_ROTATION
    int "Display rotation"
    range 0 270
    default 270

config EPUB_READER_TOUCH_POLL_MS
    int "Touch poll interval (ms)"
    range 10 1000
    default 50

config EPUB_READER_TASK_STACK_SIZE
    int "Reader task stack size (bytes)"
    range 16384 131072
    default 98304

endmenu
```

## examples/epd_refresh_demo/sdkconfig.defaults
```kconfig
CONFIG_IDF_TARGET="esp32p4"
CONFIG_IDF_TARGET_ESP32P4=y

# IDF 6.0.1 represents ESP32-P4 v3.2 with the v3.1-v3.99 range.
CONFIG_ESP32P4_REV_MIN_301=y

CONFIG_PARTITION_TABLE_CUSTOM=y
CONFIG_PARTITION_TABLE_CUSTOM_FILENAME="partitions.csv"
CONFIG_PARTITION_TABLE_FILENAME="partitions.csv"
CONFIG_PARTITION_TABLE_OFFSET=0x8000
CONFIG_PARTITION_TABLE_MD5=y

CONFIG_ESPTOOLPY_FLASHSIZE_16MB=y
CONFIG_COMPILER_OPTIMIZATION_PERF=y
CONFIG_FREERTOS_HZ=1000

CONFIG_SPIRAM=y
CONFIG_SPIRAM_SPEED_200M=y
CONFIG_SPIRAM_USE_MALLOC=y
CONFIG_SPIRAM_MEMTEST=n
CONFIG_CACHE_L2_CACHE_256KB=y
CONFIG_CACHE_L2_CACHE_LINE_128B=y
```

## examples/epd_wifi_auto_scan/sdkconfig.defaults
```kconfig
CONFIG_IDF_TARGET="esp32p4"
CONFIG_IDF_TARGET_ESP32P4=y

CONFIG_PARTITION_TABLE_CUSTOM=y
CONFIG_PARTITION_TABLE_CUSTOM_FILENAME="partitions.csv"
CONFIG_PARTITION_TABLE_FILENAME="partitions.csv"
CONFIG_PARTITION_TABLE_OFFSET=0x8000
CONFIG_PARTITION_TABLE_MD5=y

CONFIG_ESPTOOLPY_FLASHSIZE_16MB=y
CONFIG_ESP_MAIN_TASK_STACK_SIZE=12288
CONFIG_BOOTLOADER_LOG_COLORS=y
CONFIG_BOOTLOADER_LOG_TIMESTAMP_SOURCE_CPU_TICKS=y
CONFIG_COMPILER_OPTIMIZATION_PERF=y
CONFIG_FREERTOS_HZ=1000

CONFIG_SPIRAM=y
CONFIG_SPIRAM_SPEED_200M=y
CONFIG_SPIRAM_USE_MALLOC=y
CONFIG_SPIRAM_MEMTEST=n
CONFIG_CACHE_L2_CACHE_256KB=y
CONFIG_CACHE_L2_CACHE_LINE_128B=y

CONFIG_IDF_EXPERIMENTAL_FEATURES=y
```

## examples/epub_reader_t5_p4/main/Kconfig.projbuild
```kconfig
menu "EPUB Reader"

config EPUB_READER_BOOK_DIR
    string "Primary EPUB directory"
    default "/sdcard/books"

config EPUB_READER_FALLBACK_DIR
    string "Fallback EPUB directory"
    default "/sdcard"

config EPUB_READER_ROTATION
    int "Display rotation"
    range 0 270
    default 270

config EPUB_READER_TOUCH_POLL_MS
    int "Touch poll interval (ms)"
    range 10 1000
    default 50

config EPUB_READER_TASK_STACK_SIZE
    int "Reader task stack size (bytes)"
    range 16384 131072
    default 65536

config EPUB_READER_BODY_LINE_GAP
    int "Extra body line gap (px)"
    range 0 16
    default 2

config EPUB_READER_PARAGRAPH_GAP
    int "Paragraph gap (px)"
    range 0 32
    default 6

config EPUB_READER_SPACE_WIDTH_PERCENT
    int "Word space width percent"
    range 0 150
    default 0

config EPUB_READER_INTER_WORD_TIGHTEN_PX
    int "Inter-word tighten overlap (px)"
    range 0 8
    default 2

config EPUB_READER_JUSTIFY_MAX_SPACE_PERCENT
    int "Maximum justified word space percent"
    range 0 250
    default 20

config EPUB_READER_ENGLISH_FIRST_LINE_INDENT
    int "English first line indent (px)"
    range 0 80
    default 28

endmenu
```

## examples/epub_reader_t5_p4/sdkconfig.defaults
```kconfig
CONFIG_IDF_TARGET="esp32p4"
CONFIG_IDF_TARGET_ESP32P4=y

CONFIG_ESPTOOLPY_FLASHSIZE_16MB=y
CONFIG_BOOTLOADER_LOG_COLORS=y
CONFIG_BOOTLOADER_LOG_TIMESTAMP_SOURCE_CPU_TICKS=y
CONFIG_COMPILER_OPTIMIZATION_PERF=y
CONFIG_ESP_MAIN_TASK_STACK_SIZE=8192
CONFIG_EPUB_READER_ROTATION=270
CONFIG_FREERTOS_HZ=1000
CONFIG_EPUB_READER_TASK_STACK_SIZE=65536
CONFIG_EPUB_READER_BODY_LINE_GAP=2
CONFIG_EPUB_READER_PARAGRAPH_GAP=6
CONFIG_EPUB_READER_SPACE_WIDTH_PERCENT=0
CONFIG_EPUB_READER_INTER_WORD_TIGHTEN_PX=2
CONFIG_EPUB_READER_JUSTIFY_MAX_SPACE_PERCENT=20
CONFIG_EPUB_READER_ENGLISH_FIRST_LINE_INDENT=28

CONFIG_SPIRAM=y
CONFIG_SPIRAM_SPEED_200M=y
CONFIG_SPIRAM_USE_MALLOC=y
CONFIG_SPIRAM_MEMTEST=n
CONFIG_CACHE_L2_CACHE_256KB=y
CONFIG_CACHE_L2_CACHE_LINE_128B=y

CONFIG_IDF_EXPERIMENTAL_FEATURES=y
CONFIG_FATFS_LFN_HEAP=y
```

## examples/es8311_mic_speak/main/Kconfig.projbuild
```kconfig
menu "Example Configuration"

    choice EXAMPLE_SELECT_MIC_GAIN
        prompt "Set MIC gain"
        default MIC_GAIN_18DB
        help
            Select analog microphone gain for the ES8311 codec

        config MIC_GAIN_0DB
            bool "0dB"
        config MIC_GAIN_6DB
            bool "6dB"
        config MIC_GAIN_12DB
            bool "12dB"
        config MIC_GAIN_18DB
            bool "18dB"
        config MIC_GAIN_24DB
            bool "24dB"
        config MIC_GAIN_30DB
            bool "30dB"
        config MIC_GAIN_36DB
            bool "36dB"
        config MIC_GAIN_42DB
            bool "42dB"
    endchoice

    config EXAMPLE_MIC_GAIN
        int
        default 0 if MIC_GAIN_0DB
        default 1 if MIC_GAIN_6DB
        default 2 if MIC_GAIN_12DB
        default 3 if MIC_GAIN_18DB
        default 4 if MIC_GAIN_24DB
        default 5 if MIC_GAIN_30DB
        default 6 if MIC_GAIN_36DB
        default 7 if MIC_GAIN_42DB

    config EXAMPLE_VOICE_VOLUME
        int "Voice volume"
        range 0 100
        default 60
        help
            Set speaker output volume
endmenu
```

## examples/es8311_spiffs/main/Kconfig.projbuild
```kconfig
menu "Example Configuration"

    config EXAMPLE_VOICE_VOLUME
        int "Speaker volume"
        range 0 100
        default 90
        help
            ES8311 output volume in percent.

    config EXAMPLE_PLAYBACK_TIMEOUT_SECONDS
        int "Playback timeout"
        range 5 600
        default 60
        help
            Maximum time to wait for a playback session to finish.

endmenu
```
