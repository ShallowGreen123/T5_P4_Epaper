## examples/sd_card_test/sdkconfig.defaults
```kconfig
CONFIG_IDF_TARGET="esp32p4"
CONFIG_IDF_TARGET_ESP32P4=y

# IDF 6.1 targets the ESP32-P4 v3.2 silicon (v3.1-v3.99 range).
CONFIG_ESP32P4_REV_MIN_301=y

#
# Serial flasher config
#
CONFIG_ESPTOOLPY_FLASHSIZE_16MB=y
CONFIG_ESPTOOLPY_NO_STUB=y
CONFIG_PARTITION_TABLE_OFFSET=0x10000

#
# FATFS
#
CONFIG_FATFS_VFS_FSTAT_BLKSIZE=4096

#
# Format
#
CONFIG_BOOTLOADER_LOG_COLORS=y
CONFIG_BOOTLOADER_LOG_TIMESTAMP_SOURCE_CPU_TICKS=y

#
# FreeRTOS
#
CONFIG_FREERTOS_HZ=1000
```

## examples/usb_device_uac/main/Kconfig.projbuild
```kconfig
menu "Example Configuration"

    choice DEVELOPMENT_BOARD_SELECTION
        prompt "Select the development board you are using"
        default ESP32_P4_T5_EPAPER if IDF_TARGET_ESP32P4
        help
            Select this option to choose the board for the example.

        config ESP32_P4_T5_EPAPER
            bool "LilyGo T5-P4 E-Paper"
            depends on IDF_TARGET_ESP32P4

    endchoice

endmenu
```

## examples_esp32s3/demo1/sdkconfig.defaults
```kconfig
CONFIG_IDF_TARGET="esp32s3"

#
# Arduino ESP32
#
CONFIG_ARDUINO_VARIANT="esp32s3"
CONFIG_AUTOSTART_ARDUINO=y

#
# Partition Table
#
CONFIG_PARTITION_TABLE_CUSTOM=y
CONFIG_PARTITION_TABLE_CUSTOM_FILENAME="partitions.csv"
CONFIG_PARTITION_TABLE_FILENAME="partitions.csv"
CONFIG_PARTITION_TABLE_OFFSET=0x8000
CONFIG_PARTITION_TABLE_MD5=y

#
# ESP PSRAM
#
CONFIG_SPIRAM=y
CONFIG_SPIRAM_MODE_OCT=y

#
# Serial flasher config
#
# CONFIG_ESPTOOLPY_FLASHSIZE_1MB is not set
# CONFIG_ESPTOOLPY_FLASHSIZE_2MB is not set
# CONFIG_ESPTOOLPY_FLASHSIZE_4MB is not set
# CONFIG_ESPTOOLPY_FLASHSIZE_8MB is not set
CONFIG_ESPTOOLPY_FLASHSIZE_16MB=y

#
# Format
#
CONFIG_BOOTLOADER_LOG_COLORS=y
CONFIG_BOOTLOADER_LOG_TIMESTAMP_SOURCE_CPU_TICKS=y

#
# FREERTOS
#
CONFIG_FREERTOS_HZ=1000
# end of FREERTOS
# end of Component config
```

## examples_esp32s3/demo3/sdkconfig.defaults
```kconfig
CONFIG_IDF_TARGET="esp32s3"

#
# Arduino ESP32
#
# CONFIG_ARDUINO_VARIANT="esp32s3"
# CONFIG_AUTOSTART_ARDUINO=y

#
# Partition Table
#
CONFIG_PARTITION_TABLE_CUSTOM=y
CONFIG_PARTITION_TABLE_CUSTOM_FILENAME="partitions.csv"
CONFIG_PARTITION_TABLE_FILENAME="partitions.csv"
CONFIG_PARTITION_TABLE_OFFSET=0x8000
CONFIG_PARTITION_TABLE_MD5=y

#
# ESP PSRAM
#
CONFIG_SPIRAM=y
CONFIG_SPIRAM_MODE_OCT=y

#
# Serial flasher config
#
# CONFIG_ESPTOOLPY_FLASHSIZE_1MB is not set
# CONFIG_ESPTOOLPY_FLASHSIZE_2MB is not set
# CONFIG_ESPTOOLPY_FLASHSIZE_4MB is not set
# CONFIG_ESPTOOLPY_FLASHSIZE_8MB is not set
CONFIG_ESPTOOLPY_FLASHSIZE_16MB=y

#
# Format
#
CONFIG_BOOTLOADER_LOG_COLORS=y
CONFIG_BOOTLOADER_LOG_TIMESTAMP_SOURCE_CPU_TICKS=y

#
# FREERTOS
#
CONFIG_FREERTOS_HZ=1000
# end of FREERTOS
# end of Component config


CONFIG_LV_USE_THEME_DEFAULT=y
# CONFIG_LV_THEME_DEFAULT_DARK is not set
CONFIG_LV_THEME_DEFAULT_GROW=y
CONFIG_LV_THEME_DEFAULT_TRANSITION_TIME=80
CONFIG_LV_USE_THEME_BASIC=y
CONFIG_LV_USE_THEME_MONO=y
```
